## firmware/sdkconfig.defaults
```kconfig
# Increase the main task stack — CydPlatform::new() initialises two SPI buses,
# a display, SD card, and touch controller; the default 3584 bytes is too small.
CONFIG_ESP_MAIN_TASK_STACK_SIZE=16384

# Run on Core 0 only — the firmware is single-threaded and doesn't schedule any
# work on Core 1.  Disabling SMP eliminates the prvSelectHighestPriorityTaskSMP
# assertion that fires when Core 1 has no runnable task during heavy init.
CONFIG_FREERTOS_UNICORE=y
```
